## src/mainboard/razer/blade_stealth_icl/Kconfig
```kconfig
if BOARD_RAZER_BLADE_STEALTH_ICL

config BOARD_SPECIFIC_OPTIONS
	def_bool y
	select BOARD_ROMSIZE_KB_16384
	select EC_ACPI
	select PLATFORM_USES_FSP2_0
	select HAVE_SPD_IN_CBFS
	select HAVE_ACPI_RESUME
	select HAVE_ACPI_TABLES
	select DRIVERS_I2C_HID
	select DRIVERS_I2C_GENERIC
	select DRIVERS_USB_ACPI
	select SOC_INTEL_COMMON_BLOCK_HDA_VERB
	select SOC_INTEL_ICELAKE
	select MAINBOARD_USES_IFD_EC_REGION
	select ADD_FSP_BINARIES
	select FSP_USE_REPO
	#select SUPERIO_ITE_IT8320VG Not yet supported

config MAINBOARD_DIR
	string
	default "razer/blade_stealth_icl"

config MAINBOARD_PART_NUMBER
	string
	default "LY320"

config MAINBOARD_FAMILY
	string
	default "BLADE_STEALTH"

config DIMM_SPD_SIZE
	default 512

config MAX_CPUS
	int
	default 8

config NO_POST
	default y

endif
```

## src/mainboard/razer/blade_stealth_icl/Kconfig.name
```kconfig
config BOARD_RAZER_BLADE_STEALTH_ICL
	bool "Blade Stealth (Ice Lake U) Mercury White late 2019 (LY320)"
```
